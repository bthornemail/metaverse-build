## firmware/esp32/esp-idf/main/Kconfig.projbuild
```kconfig
menu "Metaverse Bus"

config PLAN_URL
    string "Plan URL"
    default "http://192.168.172.43:7070/"

endmenu
```

## firmware/esp32/esp-idf/sdkconfig.defaults
```kconfig
# Wi-Fi credentials
CONFIG_ESP_WIFI_SSID="metaverse-portal"
CONFIG_ESP_WIFI_PASSWORD="passwd256"

# Plan URL (HTTP)
CONFIG_PLAN_URL="http://192.168.172.43:7070/"

# Logging
CONFIG_LOG_DEFAULT_LEVEL_INFO=y
```
